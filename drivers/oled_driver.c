#include "oled_driver.h"

/* I2C 引脚: SCL=PB8, SDA=PB9 */
#define I2C_SCL_PORT   GPIOB
#define I2C_SCL_PIN    GPIO_PIN_8
#define I2C_SDA_PORT   GPIOB
#define I2C_SDA_PIN    GPIO_PIN_9
#define I2C_GPIO_RCU   RCU_GPIOB

#define SCL_H()  gpio_bit_set(I2C_SCL_PORT, I2C_SCL_PIN)
#define SCL_L()  gpio_bit_reset(I2C_SCL_PORT, I2C_SCL_PIN)
#define SDA_H()  gpio_bit_set(I2C_SDA_PORT, I2C_SDA_PIN)
#define SDA_L()  gpio_bit_reset(I2C_SDA_PORT, I2C_SDA_PIN)
#define SDA_IN() gpio_mode_set(I2C_SDA_PORT, GPIO_MODE_INPUT, GPIO_PUPD_PULLUP, I2C_SDA_PIN)
#define SDA_OUT() gpio_mode_set(I2C_SDA_PORT, GPIO_MODE_OUTPUT, GPIO_PUPD_NONE, I2C_SDA_PIN)
#define SDA_RD() gpio_input_bit_get(I2C_SDA_PORT, I2C_SDA_PIN)

/* SSD1306 命令 */
#define OLED_CMD_MODE  0x00
#define OLED_DAT_MODE  0x40

static u8 oled_buffer[OLED_WIDTH * OLED_HEIGHT / 8];

/* ---- I2C 位操作 ---- */
static void i2c_delay(void)
{
    for (volatile u8 i = 0; i < 10; i++) { __NOP(); }
}

static void i2c_start(void)
{
    SDA_OUT();
    SDA_H();
    SCL_H();
    i2c_delay();
    SDA_L();
    i2c_delay();
    SCL_L();
}

static void i2c_stop(void)
{
    SDA_OUT();
    SDA_L();
    SCL_H();
    i2c_delay();
    SDA_H();
    i2c_delay();
}

static void i2c_send_byte(u8 dat)
{
    SDA_OUT();
    for (u8 i = 0; i < 8; i++) {
        if (dat & 0x80) SDA_H(); else SDA_L();
        dat <<= 1;
        SCL_H();
        i2c_delay();
        SCL_L();
    }
    /* ACK */
    SDA_IN();
    SCL_H();
    i2c_delay();
    SCL_L();
    SDA_OUT();
}

static void oled_send_cmd(u8 cmd)
{
    i2c_start();
    i2c_send_byte((OLED_I2C_ADDR << 1) | 0);
    i2c_send_byte(OLED_CMD_MODE);
    i2c_send_byte(cmd);
    i2c_stop();
}

static void oled_send_data(u8 dat)
{
    i2c_start();
    i2c_send_byte((OLED_I2C_ADDR << 1) | 0);
    i2c_send_byte(OLED_DAT_MODE);
    i2c_send_byte(dat);
    i2c_stop();
}

/* ---- SSD1306 初始化命令序列 ---- */
void oled_hw_init(void)
{
    rcu_periph_clock_enable(I2C_GPIO_RCU);

    gpio_mode_set(I2C_SCL_PORT, GPIO_MODE_OUTPUT, GPIO_PUPD_NONE, I2C_SCL_PIN);
    gpio_output_options_set(I2C_SCL_PORT, GPIO_OTYPE_PP, GPIO_OSPEED_50MHZ, I2C_SCL_PIN);
    gpio_mode_set(I2C_SDA_PORT, GPIO_MODE_OUTPUT, GPIO_PUPD_NONE, I2C_SDA_PIN);
    gpio_output_options_set(I2C_SDA_PORT, GPIO_OTYPE_PP, GPIO_OSPEED_50MHZ, I2C_SDA_PIN);

    SCL_H(); SDA_H();

    oled_send_cmd(0xAE); /* 关闭显示 */
    oled_send_cmd(0x00); /* 低列地址 */
    oled_send_cmd(0x10); /* 高列地址 */
    oled_send_cmd(0x40); /* 起始行 */
    oled_send_cmd(0xB0); /* 页地址 */
    oled_send_cmd(0x81); /* 对比度 */
    oled_send_cmd(0xFF);
    oled_send_cmd(0xA1); /* 段重映射 */
    oled_send_cmd(0xA6); /* 正常显示 */
    oled_send_cmd(0xA8); /* 复用比 */
    oled_send_cmd(0x1F); /* 32-1 */
    oled_send_cmd(0xC8); /* COM 扫描方向 */
    oled_send_cmd(0xD3); /* 偏移 */
    oled_send_cmd(0x00);
    oled_send_cmd(0xD5); /* 时钟分频 */
    oled_send_cmd(0xF0);
    oled_send_cmd(0xD9); /* 预充电 */
    oled_send_cmd(0x22);
    oled_send_cmd(0xDA); /* COM 引脚 */
    oled_send_cmd(0x02);
    oled_send_cmd(0xDB); /* VCOMH */
    oled_send_cmd(0x20);
    oled_send_cmd(0x8D); /* 电荷泵 */
    oled_send_cmd(0x14);
    oled_send_cmd(0xAF); /* 开启显示 */

    memset(oled_buffer, 0, sizeof(oled_buffer));
}

void oled_clear_screen(void)
{
    memset(oled_buffer, 0, sizeof(oled_buffer));
}

void oled_refresh(void)
{
    for (u8 page = 0; page < OLED_HEIGHT / 8; page++) {
        oled_send_cmd(0xB0 + page);
        oled_send_cmd(0x00);
        oled_send_cmd(0x10);
        for (u8 col = 0; col < OLED_WIDTH; col++) {
            oled_send_data(oled_buffer[page * OLED_WIDTH + col]);
        }
    }
}

/* 6x8 ASCII 字体（部分，空格到 ~） */
static const u8 font_6x8[][6] = {
    {0x00,0x00,0x00,0x00,0x00,0x00}, /* SPACE */
    {0x00,0x00,0x5F,0x00,0x00,0x00}, /* ! */
    {0x00,0x07,0x00,0x07,0x00,0x00}, /* " */
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    {0x61,0x51,0x49,0x45,0x43,0x00}, /* Z */
};

void oled_show_text(u8 row, u8 col, const char* text, u8 font_size)
{
    if (text == NULL || font_size != 16) return;

    u8 page = row;
    u8 x    = col;

    while (*text) {
        char c = *text++;
        if (c < 32 || c > 126) c = ' ';
        u8 idx = c - 32;

        for (u8 i = 0; i < 6 && x < OLED_WIDTH; i++) {
            oled_buffer[page * OLED_WIDTH + x] = font_6x8[idx][i];
            x++;
        }
        /* 字符间距 */
        if (x < OLED_WIDTH) {
            oled_buffer[page * OLED_WIDTH + x] = 0x00;
            x++;
        }
    }
}

void oled_display_time_value(const char* time_str, const char* value_str)
{
    oled_clear_screen();
    oled_show_text(0, 0, time_str, 16);
    oled_show_text(1, 0, value_str, 16);
    oled_refresh();
}
